## adhesion/px4-overlay/src/modules/height_commander/Kconfig
```kconfig
menuconfig MODULES_HEIGHT_COMMANDER
	bool "height_commander"
	default n
	---help---
		Enable support for HeightCommander module.
```

## adhesion/px4-overlay/src/modules/mylink_bridge/Kconfig
```kconfig
menuconfig MODULES_MYLINK_BRIDGE
	bool "mylink_bridge"
	default n
	---help---
		Enable support for MyLink bridge module.
```
